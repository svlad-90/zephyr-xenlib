## Kconfig
```kconfig
# Copyright (c) 2024 EPAM Systems
# SPDX-License-Identifier: Apache-2.0

if XEN

config XEN_STORE_COMMON
	bool
	help
	  Common code for handling xenstore.

config XEN_STORE_SRV
	bool "Enable XenStore server"
	select XEN_STORE_COMMON
	help
	  Enable xenstore server library. It should be included
	  if you are running Zephyr as Dom0.

config XEN_STORE_SRV_SHELL_CMDS
	depends on SHELL
	depends on XEN_STORE_SRV
	default y
	bool "Enable XenStore server shell"
	help
	  Enable shell for XenStore server.

config XEN_STORE_CLI
	bool "Enable XenStore client library"
	select XEN_STORE_COMMON
	help
	  Enable the XenStore client library used to talk to the Xen hypervisor's
	  key/value store.
	  Applications can use it to read and write configuration data and runtime
	  state via XenStore.


if XEN_STORE_CLI

config XEN_STORE_CLI_WORKQ_PRIORITY
	int "XenStore CLI workqueue priority"
	depends on XEN_STORE_CLI
	default 0
	help
	  Thread priority for the xenstore-cli workqueue.

config XEN_STORE_CLI_WORKQ_STACK_SIZE
	int "XenStore CLI workqueue stack size"
	depends on XEN_STORE_CLI
	default 32768
	help
	  Stack size for the xenstore-cli workqueue thread.

endif

config XEN_BLKFRONT
	bool "Enable Xen PV block frontend"
	depends on XEN_STORE_CLI
	depends on XEN_GRANT_TABLE
	depends on XEN_EVENTS
	help
	  Enable a Xen paravirtual block frontend. Each frontend connects one
	  virtual block device through XenStore, discovers backend capabilities,
	  and supports serialized read, write, flush, and discard requests.
	  Public read and write calls may cover more than one Xen page, but the
	  backend-facing protocol path still uses ordinary Xen block requests
	  with a bounded multi-segment data grant limit per request. Indirect
	  descriptors, persistent grants, and multiple queues are discovered but
	  not used for request submission.

if XEN_BLKFRONT

config XEN_BLKFRONT_DISK_ACCESS
	bool "Expose Xen PV block frontend as a Zephyr disk"
	depends on DISK_ACCESS
	help
	  Discover Xen PV block frontend entries published under the guest
	  XenStore device tree and register them as Zephyr disk_access disks. This
	  adapter supports read/write, cache sync, and physical erase when each
	  backend advertises the corresponding write, flush, and discard support.

config XEN_BLKFRONT_MAX_DISKS
	int "Maximum Xen PV block disks to expose"
	depends on XEN_BLKFRONT_DISK_ACCESS
	default 4
	range 1 16
	help
	  Maximum number of XenStore vbd entries to register as Zephyr disk_access
	  disks. Extra XenStore entries remain unregistered.

config XEN_BLKFRONT_DISK_NAME_PREFIX
	string "Xen PV block disk name prefix"
	depends on XEN_BLKFRONT_DISK_ACCESS
	default "XENBLK"
	help
	  Prefix used for disk_access names. Discovered disks are registered as
	  XENBLK0, XENBLK1, and so on by default.

config XEN_BLKFRONT_DEVICE_ROOT
	string "XenStore vbd device root"
	depends on XEN_BLKFRONT_DISK_ACCESS
	default "device/vbd"
	help
	  XenStore directory containing vbd frontend entries for this guest. The
	  default is relative to the guest domain path, so it resolves to this
	  domain's /local/domain/<domid>/device/vbd tree. Each child node is
	  treated as one virtual block-device id.

config XEN_BLKFRONT_BACKEND_DOMID
	int "Fallback Xen PV block backend domain id"
	depends on XEN_BLKFRONT_DISK_ACCESS
	default 0
	help
	  Backend domain id used only when the backend path published in XenStore
	  does not follow the normal /local/domain/<domid>/backend/vbd/... shape.

config XEN_BLKFRONT_XS_TIMEOUT_MS
	int "Xen PV block XenStore request timeout in milliseconds"
	depends on XEN_BLKFRONT_DISK_ACCESS
	default 1000

config XEN_BLKFRONT_XS_BUF_SIZE
	int "Xen PV block XenStore temporary buffer size"
	depends on XEN_BLKFRONT_DISK_ACCESS
	default 512

endif # XEN_BLKFRONT

config XEN_LIBFDT
	bool "Enable libfdt support"
	help
	  Enable libfdt module. This module allows you to generate
	  Domain device tree based on the parameters set in the
	  Domain config. It provides complete toolset to work with
	  flattened device tree.

config PARTIAL_DEVICE_TREE_SIZE
	int "Domain device tree size"
	default 8192
	help
	  Maximum size of the domain device tree

config XEN_DOMAIN_MANAGEMENT
	bool "Enable Xen Domain Management"
	help
	  Enable domain management library. This library allows you
	  to create, destroy and manage xen domains.

config XEN_DOMAIN_MANAGEMENT_SHELL_CMDS
	depends on SHELL
	depends on XEN_DOMAIN_MANAGEMENT
	default y
	bool "Enable Xen domain management shell"
	help
	  Enable shell for Xen domain management.

config XEN_DOMCFG_SECTION
	bool "Enable Xen domain config section"
	default y
	depends on XEN_DOMAIN_MANAGEMENT
	help
	  Enable gathering domain configurations to a common section.
	  This allows you to declare multiple domain configs with
	  a DECL_CONFIG macro. Configs can be later accessed by
	  their name.

config XEN_DOMCFG_READ_PDT
	bool "Enable reading of domain partial device-tree (PDT) binary"
	default y
	depends on XEN_DOMAIN_MANAGEMENT
	help
	  Enables reading of domain partial device-tree (PDT) binary by using
	  callbacks in struct xen_domain_cfg.
	  It also enables this feature in "xu create" shell command which will
	  try to load PDT binary using struct xen_domain_cfg callbacks.

config XEN_CONSOLE_SRV
	bool "Enable Xen Console server"
	help
	  Enable xen console server. It should be included if you
	  are running Zephyr as Dom0, otherwise any DomU that uses
	  Xen para-virtual console (PVC) may lock up. On other hand,
	  this server can be omitted if you are certain that DomUs
	  will never touch PV console.

config XEN_SHELL
	bool "Enable Xen shell commands"
	select SHELL
	help
	  Enable set of Xen shell commands for domain management.

config XENSTORE_SHELL_READ_SIZE
	int "Size of xs read buffer"
	default 256
	depends on XEN_SHELL
	help
	  Sets the maximum size that xs read cmd can handle

config XENSTORE_TREE_TRAVERSE_DEPTH
	int "Maximum xs traverse depth"
	default 8
	range 1 16
	help
	  Sets the maximum xs traverse depth to avoid stack overflow
	  in case of deeply nested XS trees.

config XEN_VCH
	bool "Enable Xen vchannels support"
	help
	  Enable vchannel communication library.

config VCH_PATH_MAXLEN
	int "Maximum length of vchannel ID to read from XenStore"
	default 32
	help
	  The maximum XenStore path size that identify a separate vchannel.

config PFN_CHUNK_SIZE
	int "Chunk size for memory mapping operations"
	default 128
	help
	  Chunk size for helper functions for mapping/unmapping
	  memory from guest domain to Dom0.

config DOMU_MAX
	int "Maximum number of DomUs"
	default 4
	range 1 32
	help
	  Maximum number of DomUs that can be created and launched.

config XSTAT
	bool "Enable XSTAT support"
	help
	  Enable xstat support which allows statistic information about running domains

config XSTAT_SHELL_CMDS
	depends on XSTAT
	depends on SHELL
	bool "Enable XSTAT shell commands"
	help
	  Enable set of XSTAT shell commands.

config XEN_DOM0LESS_BOOT
	bool "Xen dom0less boot support [EXPERIMENTAL]"
	help
	  Enable to support Xen dom0less boot. The domains started by Xen
	  will be identified and added to xenlib domain management subsystem, for each domain
	  xenstore will be initialized.

	  This is EXPERIMENTAL and depends on work in Xen mainline.

endif # XEN
```
